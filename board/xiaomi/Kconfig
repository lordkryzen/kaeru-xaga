## board/xiaomi/Kconfig
```kconfig
config XIAOMI_XAGA
    bool "Support POCO X4 GT / Redmi Note 11T Pro / Redmi K50i (xaga), AArch64"
    depends on ARCH_ARM64

config XIAOMI_NIKEL
    bool "Support Redmi Note 4"
    default n
    help
      Say Y if you want to include support for Redmi Note 4

config XIAOMI_ROSEMARY
    bool "Support Redmi 10S / POCO M5s"
    default n
    help
      Say Y if you want to include support for Redmi 10S / POCO M5s

config XIAOMI_EARTH
    bool "Support Redmi 12C / POCO C55"
    default n
    help
      Say Y if you want to include support for Redmi 12C / POCO C55

config XIAOMI_FLEUR
    bool "Support Redmi Note 11S 4G"
    default n
    help
      Say Y if you want to include support for Redmi Note 11S 4G

config XIAOMI_RUBY
    bool "Support Redmi Note 12 Pro/Pro+/Discovery 5G/Pro+ 5G"
    default n
    help
      Say Y if you want to include support for Redmi Note 12 Pro/Pro+/Discovery 5G/Pro+ 5G

config XIAOMI_FIRE
    bool "Support Redmi 12 4G"
    default n
    help
      Say Y if you want to include support for Redmi 12 4G

config XIAOMI_LANCELOT
    bool "Support Redmi 9/Redmi 9 Prime"
    default n
    help
      Say Y if you want to include support for Redmi 9/Redmi 9 Prime

config XIAOMI_MERLIN
    bool "Support Redmi 10X 4G/Redmi Note 9"
    default n
    help
      Say Y if you want to include support for Redmi 10X 4G/Redmi Note 9

config XIAOMI_BEGONIA
    bool "Support Redmi Note 8 Pro"
    default n
    help
      Say Y if you want to include support for Redmi Note 8 Pro

config XIAOMI_PISSARRO
    bool "Support Redmi Note 11 Pro+ 5G"
    default n
    help
      Say Y if you want to include support for Redmi Note 11 Pro+ 5G

config XIAOMI_LIGHT
    bool "Support POCO M4 5G / Redmi 10 5G / Redmi 11 Prime 5G / Redmi Note 11E/11R"
    default n
    help
      Say Y if you want to include support for POCO M4 5G / Redmi 10 5G / Redmi 11 Prime 5G / Redmi Note 11E/11R

if XIAOMI_XAGA
config BOOT_SELECT_ADDRESS
    hex "Native boot selection function"
config BOOT_SELECT_CALLER
    hex "Native boot selection call site"
config SELECTED_BOOTMODE_ADDRESS
    hex "Native selected boot app byte"
config KEY_DETECT_ADDRESS
    hex "Native hardware key reader"
config AVB_BOOT_STATE_ADDRESS
    hex "Native AVB boot state word"
config AVB_SET_BOOT_STATE_ADDRESS
    hex "Native AVB boot state setter"
config OTP_VERSION_INIT_ADDRESS
    hex "Native read-only OTP version table initializer"
config AVB_SLOT_VERIFY_ADDRESS
    hex "Native AVB slot verifier"
config AVB_SLOT_VERIFY_CALLER
    hex "Native AVB slot verification call site"
config ENV_INIT_ADDRESS
    hex "ENV_INIT_ADDRESS"
config GET_LOCK_STATE_ADDRESS
    hex "GET_LOCK_STATE_ADDRESS"
config VFY_POLICY_ADDRESS
    hex "VFY_POLICY_ADDRESS"
config DM_VERITY_WARNING_ADDRESS
    hex "DM_VERITY_WARNING_ADDRESS"
config BIO_OPEN_ADDRESS
    hex "BIO_OPEN_ADDRESS"
config BIO_CLOSE_ADDRESS
    hex "BIO_CLOSE_ADDRESS"
config BIO_READ_ADDRESS
    hex "BIO_READ_ADDRESS"
config BIO_WRITE_ADDRESS
    hex "BIO_WRITE_ADDRESS"
config BIO_DEVICE_LIST_ADDRESS
    hex "BIO_DEVICE_LIST_ADDRESS"
config FASTBOOT_TRANSPORT_ADDRESS
    hex "FASTBOOT_TRANSPORT_ADDRESS"
config ENV_INIT_CALLER
    hex "Native environment init call site"
endif
```

## configs/xiaomi/xaga_defconfig
```kconfig
# SPDX-License-Identifier: AGPL-3.0-or-later

CONFIG_ARCH_ARM64=y
CONFIG_XIAOMI_XAGA=y
CONFIG_MEDIATEK_MT6895=y
CONFIG_NATIVE_PRINTF_LOG=y
CONFIG_LK_LOG_STORE=n
CONFIG_ENVIRONMENT_SUPPORT=y
CONFIG_SPOOF_SUPPORT=y
CONFIG_THREAD_SUPPORT=y
CONFIG_NATIVE_BIO_STORAGE=y
CONFIG_FASTBOOT_FETCH_COMMAND=y
CONFIG_FASTBOOT_STYLE_STANDARD=y
CONFIG_APP_ADDRESS=0xFFFF000050F0E9B8
CONFIG_BOOTMODE_ADDRESS=0xFFFF000050FF2094
CONFIG_BOOTLOADER_BASE=0xFFFF000050F00000
CONFIG_BOOTLOADER_SIZE=0xC3418
CONFIG_DPRINTF_ADDRESS=0xFFFF000050F69B04
CONFIG_VIDEO_PRINTF_ADDRESS=0xFFFF000050F3B658
CONFIG_PLATFORM_INIT_CALLER=0xFFFF000050F04D88
CONFIG_PLATFORM_INIT_ADDRESS=0xFFFF000050F02560
CONFIG_FASTBOOT_REGISTER_ADDRESS=0xFFFF000050F04FCC
CONFIG_FASTBOOT_PUBLISH_ADDRESS=0xFFFF000050F05090
CONFIG_FASTBOOT_FAIL_ADDRESS=0xFFFF000050F05340
CONFIG_FASTBOOT_OKAY_ADDRESS=0xFFFF000050F05378
CONFIG_FASTBOOT_INFO_ADDRESS=0xFFFF000050F052A0
CONFIG_FASTBOOT_CMDLIST_ADDRESS=0xFFFF000050FF2118
CONFIG_GET_ENV_ADDRESS=0xFFFF000050F33534
CONFIG_SET_ENV_ADDRESS=0xFFFF000050F335F0
CONFIG_ENV_INIT_ADDRESS=0xFFFF000050F33368
CONFIG_ENV_INIT_CALLER=0xFFFF000050F026C0
CONFIG_GET_LOCK_STATE_ADDRESS=0xFFFF000050F29DC0
CONFIG_VFY_POLICY_ADDRESS=0xFFFF000050F71E1C
CONFIG_DM_VERITY_WARNING_ADDRESS=0xFFFF000050F513DC
CONFIG_THREAD_CREATE_ADDRESS=0xFFFF000050F10344
CONFIG_THREAD_RESUME_ADDRESS=0xFFFF000050F10364
CONFIG_BIO_OPEN_ADDRESS=0xFFFF000050F6769C
CONFIG_BIO_CLOSE_ADDRESS=0xFFFF000050F6762C
CONFIG_BIO_READ_ADDRESS=0xFFFF000050F67728
CONFIG_BIO_WRITE_ADDRESS=0xFFFF000050F67798
CONFIG_BIO_DEVICE_LIST_ADDRESS=0xFFFF000050FC1FD0
CONFIG_FASTBOOT_GETVAR_ADDRESS=0xFFFF000050F05FC4
CONFIG_FASTBOOT_TRANSPORT_ADDRESS=0xFFFF000050FF2128
CONFIG_MALLOC_ADDRESS=0xFFFF000050F68774
CONFIG_FREE_ADDRESS=0xFFFF000050F688A4
CONFIG_UART_BASE=0xFFFF000011001000
CONFIG_WDT_BASE=0xFFFF00001C007000
CONFIG_SECURITY_AO_BASE=0xFFFF00001C00B000
CONFIG_SEJ_BASE=0xFFFF00001000A000

# Unused by native BIO storage and the resident AArch64 loader.
CONFIG_FASTBOOT_USB_WRITE_ADDRESS=0x0
CONFIG_MT_PART_GET_DEVICE_ADDRESS=0x0
CONFIG_INIT_STORAGE_CALLER=0x0
CONFIG_INIT_STORAGE_ADDRESS=0x0
CONFIG_PARTITION_READ_ADDRESS=0x0
CONFIG_PARTITION_GET_SIZE_BY_NAME_ADDRESS=0x0
CONFIG_AVB_BOOT_STATE_ADDRESS=0xFFFF000050FBE248
CONFIG_AVB_SET_BOOT_STATE_ADDRESS=0xFFFF000050F51DF4
CONFIG_OTP_VERSION_INIT_ADDRESS=0xFFFF000050F79E84
CONFIG_AVB_SLOT_VERIFY_ADDRESS=0xFFFF000050F5960C
CONFIG_AVB_SLOT_VERIFY_CALLER=0xFFFF000050F51A18
CONFIG_BOOT_SELECT_ADDRESS=0xFFFF000050F0B350
CONFIG_BOOT_SELECT_CALLER=0xFFFF000050F0E9CC
CONFIG_SELECTED_BOOTMODE_ADDRESS=0xFFFF000050FF3A18
CONFIG_KEY_DETECT_ADDRESS=0xFFFF000050F22138
```
